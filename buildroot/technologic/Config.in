## buildroot/technologic/Config.in
```kconfig
source "$BR2_EXTERNAL_TS4100_ENVIRON_PATH/package/ts4100-environ/Config.in"
source "$BR2_EXTERNAL_TS4100_ENVIRON_PATH/package/ts-pixel-font/Config.in"
```

## buildroot/technologic/configs/ts4100_environ_defconfig
```kconfig
BR2_arm=y
BR2_cortex_a7=y
BR2_ARM_FPU_NEON_VFPV4=y
BR2_CCACHE=y
BR2_KERNEL_HEADERS_4_9=y
BR2_TOOLCHAIN_BUILDROOT_WCHAR=y
BR2_TOOLCHAIN_BUILDROOT_CXX=y
BR2_TARGET_GENERIC_HOSTNAME="ts4100-environ"
BR2_ROOTFS_DEVICE_CREATION_DYNAMIC_MDEV=y
# BR2_TARGET_GENERIC_REMOUNT_ROOTFS_RW is not set
BR2_ROOTFS_POST_BUILD_SCRIPT="$(BR2_EXTERNAL_TS4100_ENVIRON_PATH)/board/ts4100-environ/post-build.sh"
BR2_LINUX_KERNEL=y
BR2_LINUX_KERNEL_CUSTOM_TARBALL=y
BR2_LINUX_KERNEL_CUSTOM_TARBALL_LOCATION="$(call github,embeddedarm,linux-4.9.y,v4.9.240-ts)/linux-v4.9.240-ts.tar.gz"
BR2_LINUX_KERNEL_DEFCONFIG="tsimx6ul"
BR2_LINUX_KERNEL_CONFIG_FRAGMENT_FILES="$(BR2_EXTERNAL_TS4100_ENVIRON_PATH)/board/ts4100-environ/tsimx6ul_defconfig-kernel-fragment"
BR2_LINUX_KERNEL_DTS_SUPPORT=y
BR2_LINUX_KERNEL_INTREE_DTS_NAME="imx6ul-ts4100"
BR2_LINUX_KERNEL_CUSTOM_DTS_PATH="$(BR2_EXTERNAL_TS4100_ENVIRON_PATH)/board/ts4100-environ/imx6ul-ts4100.dts"
BR2_LINUX_KERNEL_INSTALL_TARGET=y
BR2_PACKAGE_LINUX_TOOLS_CPUPOWER=y
BR2_PACKAGE_LINUX_TOOLS_GPIO=y
BR2_PACKAGE_LINUX_TOOLS_IIO=y
BR2_PACKAGE_BUSYBOX_SHOW_OTHERS=y
BR2_PACKAGE_BUSYBOX_WATCHDOG=y
BR2_PACKAGE_BUSYBOX_WATCHDOG_PERIOD="30"
BR2_PACKAGE_SED=y
BR2_PACKAGE_MMC_UTILS=y
BR2_PACKAGE_NFS_UTILS=y
# BR2_PACKAGE_NFS_UTILS_RPC_NFSD is not set
BR2_PACKAGE_RNG_TOOLS=y
BR2_PACKAGE_SPI_TOOLS=y
BR2_PACKAGE_CA_CERTIFICATES=y
BR2_PACKAGE_LIBOPENSSL_BIN=y
BR2_PACKAGE_PANGO=y
BR2_PACKAGE_LIBGPIOD_TOOLS=y
BR2_PACKAGE_LIBCURL_CURL=y
# BR2_PACKAGE_LIBCURL_EXTRA_PROTOCOLS_FEATURES is not set
BR2_PACKAGE_HAVEGED=y
BR2_PACKAGE_DROPBEAR=y
BR2_PACKAGE_IPROUTE2=y
BR2_PACKAGE_IW=y
BR2_PACKAGE_NTP=y
BR2_PACKAGE_NTP_NTPDATE=y
BR2_PACKAGE_WIRELESS_REGDB=y
BR2_PACKAGE_WIRELESS_TOOLS=y
BR2_PACKAGE_WPA_SUPPLICANT=y
BR2_PACKAGE_WPA_SUPPLICANT_AP_SUPPORT=y
BR2_PACKAGE_WPA_SUPPLICANT_AUTOSCAN=y
BR2_PACKAGE_WPA_SUPPLICANT_EAP=y
BR2_PACKAGE_WPA_SUPPLICANT_HOTSPOT=y
BR2_PACKAGE_WPA_SUPPLICANT_WPA3=y
BR2_PACKAGE_WPA_SUPPLICANT_CLI=y
BR2_PACKAGE_WPA_SUPPLICANT_WPA_CLIENT_SO=y
BR2_PACKAGE_WPA_SUPPLICANT_PASSPHRASE=y
BR2_PACKAGE_WPA_SUPPLICANT_DBUS=y
BR2_PACKAGE_KMOD=y
BR2_PACKAGE_KMOD_TOOLS=y
BR2_PACKAGE_UTIL_LINUX_FSCK=y
BR2_PACKAGE_UTIL_LINUX_HWCLOCK=y
BR2_TARGET_ROOTFS_TAR_XZ=y
BR2_PACKAGE_HOST_UBOOT_TOOLS=y
BR2_PACKAGE_TS4100_ENVIRON=y
BR2_PACKAGE_TS_PIXEL_FONT=y
BR2_PACKAGE_TS4100_UTILS=y
BR2_PACKAGE_WILC_FIRMWARE=y
BR2_PACKAGE_WILC_FIRMWARE_15_3_1=y
```

## buildroot/technologic/package/ts-pixel-font/Config.in
```kconfig
config BR2_PACKAGE_TS_PIXEL_FONT
	bool "ts-pixel-font"
	help
	  Package containing the TTF font used for the LCD display

	  This font is a 4x5 pixel font and works quite well on a 128x64 px
	  display.
```

## buildroot/technologic/package/ts4100-environ/Config.in
```kconfig
config BR2_PACKAGE_TS4100_ENVIRON
	bool "ts4100-environ"
	select BR2_PACKAGE_CAIRO
	select BR2_PACKAGE_LIBCURL
	help
	  Package for the actual running application
```
